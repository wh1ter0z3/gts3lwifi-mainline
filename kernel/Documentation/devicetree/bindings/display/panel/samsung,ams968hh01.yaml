## kernel/Documentation/devicetree/bindings/display/panel/samsung,ams968hh01.yaml
```yaml
# SPDX-License-Identifier: (GPL-2.0-only OR BSD-2-Clause)
%YAML 1.2
---
$id: http://devicetree.org/schemas/display/panel/samsung,ams968hh01.yaml#
$schema: http://devicetree.org/meta-schemas/core.yaml#

title: Samsung AMS968HH01 QXGA AMOLED panel (Anapass ANA38401 DDI)

description:
  2048x1536 AMOLED panel driven over two MIPI DSI links in command mode,
  used in the Samsung Galaxy Tab S3. The panel node is a child of the
  master DSI controller and has two input ports.

allOf:
  - $ref: panel-common.yaml#

properties:
  compatible:
    const: samsung,ams968hh01

  reg:
    maxItems: 1

  vdd-supply:
    description: panel 3.3 V supply

  reset-gpios: true

  tcon-ready-gpios:
    maxItems: 1
    description: input raised by the DDI once it accepts commands

  ports:
    $ref: /schemas/graph.yaml#/properties/ports
    properties:
      port@0:
        $ref: /schemas/graph.yaml#/properties/port
        description: first (master) DSI link, carries commands and the left half
      port@1:
        $ref: /schemas/graph.yaml#/properties/port
        description: second DSI link, right half
    required:
      - port@0
      - port@1

required:
  - compatible
  - reg
  - vdd-supply
  - reset-gpios
  - tcon-ready-gpios
  - ports

additionalProperties: false
```

## kernel/Documentation/devicetree/bindings/i2c/i2c-hotplug-extcon.yaml
```yaml
# SPDX-License-Identifier: (GPL-2.0-only OR BSD-2-Clause)
%YAML 1.2
---
$id: http://devicetree.org/schemas/i2c/i2c-hotplug-extcon.yaml#
$schema: http://devicetree.org/meta-schemas/core.yaml#

title: Extcon detected hot-plugged I2C bus

maintainers:
  - Jayden Milne <linux@jayd.ml>

description:
  An I2C bus that runs to a connector, where the devices behind the
  connector come and go with an accessory, and an extcon device reports
  the accessory as a dock (EXTCON_DOCK). An example is a keyboard cover
  on pogo pins that a USB interface controller recognises by the
  resistance on its ID pin. The child nodes describe the accessory's
  devices; they are added when the accessory is attached and removed
  when it is detached.

allOf:
  - $ref: /schemas/i2c/i2c-controller.yaml#

properties:
  compatible:
    const: i2c-hotplug-extcon

  extcon:
    $ref: /schemas/types.yaml#/definitions/phandle
    description: The extcon device that reports the accessory.

  i2c-parent:
    $ref: /schemas/types.yaml#/definitions/phandle
    description: The I2C bus that the connector's I2C lines are on.

required:
  - compatible
  - extcon
  - i2c-parent

unevaluatedProperties: false

examples:
  - |
    #include <dt-bindings/interrupt-controller/irq.h>

    i2c-cover {
        compatible = "i2c-hotplug-extcon";
        extcon = <&muic>;
        i2c-parent = <&pogo_i2c>;
        #address-cells = <1>;
        #size-cells = <0>;

        keyboard@40 {
            compatible = "st,stmpe1801";
            reg = <0x40>;
            interrupt-parent = <&tlmm>;
            interrupts = <54 IRQ_TYPE_LEVEL_LOW>;
        };
    };
...
```
