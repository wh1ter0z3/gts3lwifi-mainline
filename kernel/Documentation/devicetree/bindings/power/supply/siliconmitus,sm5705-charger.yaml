## kernel/Documentation/devicetree/bindings/power/supply/siliconmitus,sm5705-charger.yaml
```yaml
# SPDX-License-Identifier: GPL-2.0-only OR BSD-2-Clause
%YAML 1.2
---
$id: http://devicetree.org/schemas/power/supply/siliconmitus,sm5705-charger.yaml#
$schema: http://devicetree.org/meta-schemas/core.yaml#

title: Silicon Mitus SM5705 charger

maintainers:
  - psigod <psigod@example.com>

description:
  The charger part of the SM5705 charger and fuel gauge IC, a switch mode
  charger for one Li-ion cell from USB or wireless input. Its boost
  converter can drive VBUS for USB OTG. The same I2C device also controls
  the flash LED.

allOf:
  - $ref: power-supply.yaml#

properties:
  compatible:
    const: siliconmitus,sm5705-charger

  reg:
    maxItems: 1

  interrupts:
    maxItems: 1

  monitored-battery: true

  extcon:
    $ref: /schemas/types.yaml#/definitions/phandle
    description:
      The SM5705 MUIC, which reports the USB charger type. The input
      current limit follows it.

  power-supplies:
    maxItems: 1
    description:
      A USB Type-C controller supplying this charger. The input current
      limit also follows the current the USB-C source allows (Type-C
      current or PD contract), whichever of the two is higher.

  led:
    type: object
    $ref: /schemas/leds/common.yaml#
    unevaluatedProperties: false
    description:
      The LED on the first flash LED output, used as a torch.

    properties:
      led-max-microamp:
        minimum: 10000
        maximum: 320000
        multipleOf: 10000
        default: 180000

  usb-otg-vbus:
    type: object
    $ref: /schemas/regulator/regulator.yaml#
    unevaluatedProperties: false
    description:
      The boost converter driving VBUS at 5.1 V, the supply of a USB OTG or
      USB Type-C source port.

  io-channels:
    maxItems: 1
    description: ADC channel of a board thermistor next to the charger

  io-channel-names:
    const: therm

  temperature-lookup-table:
    $ref: /schemas/types.yaml#/definitions/int32-matrix
    description:
      The ADC's raw code at each temperature, with the codes rising.
    items:
      items:
        - description: temperature in millidegrees Celsius
        - description: raw ADC code

dependencies:
  io-channels: [ io-channel-names, temperature-lookup-table ]

required:
  - compatible
  - reg

unevaluatedProperties: false

examples:
  - |
    #include <dt-bindings/interrupt-controller/irq.h>
    #include <dt-bindings/leds/common.h>

    i2c {
      #address-cells = <1>;
      #size-cells = <0>;

      charger@49 {
        compatible = "siliconmitus,sm5705-charger";
        reg = <0x49>;
        interrupts-extended = <&tlmm 38 IRQ_TYPE_LEVEL_LOW>;
        monitored-battery = <&battery>;
        extcon = <&muic>;
        power-supplies = <&typec>;

        led {
          function = LED_FUNCTION_TORCH;
          color = <LED_COLOR_ID_WHITE>;
          led-max-microamp = <180000>;
        };

        usb-otg-vbus {
          regulator-name = "usb_otg_vbus";
        };
      };
    };
```

## kernel/Documentation/devicetree/bindings/power/supply/siliconmitus,sm5705-fuel-gauge.yaml
```yaml
# SPDX-License-Identifier: GPL-2.0-only OR BSD-2-Clause
%YAML 1.2
---
$id: http://devicetree.org/schemas/power/supply/siliconmitus,sm5705-fuel-gauge.yaml#
$schema: http://devicetree.org/meta-schemas/core.yaml#

title: Silicon Mitus SM5705 fuel gauge

maintainers:
  - psigod <psigod@example.com>

description:
  The fuel gauge part of the SM5705 charger and fuel gauge IC. It sits on
  its own I2C address and measures the battery voltage and current and
  computes the state of charge. Its temperature register reads the IC, which
  also holds the charger, so a board with a battery thermistor on an ADC should
  describe that.

allOf:
  - $ref: power-supply.yaml#

properties:
  compatible:
    const: siliconmitus,sm5705-fuel-gauge

  reg:
    maxItems: 1

  interrupts:
    maxItems: 1
    description: Low state of charge alert

  monitored-battery: true

  power-supplies: true

  io-channels:
    maxItems: 1
    description: ADC channel of the battery thermistor

  io-channel-names:
    const: therm

  temperature-lookup-table:
    $ref: /schemas/types.yaml#/definitions/int32-matrix
    description:
      The ADC's raw code at each temperature, with the codes rising.
    items:
      items:
        - description: temperature in millidegrees Celsius
        - description: raw ADC code

dependencies:
  io-channels: [ io-channel-names, temperature-lookup-table ]

required:
  - compatible
  - reg

additionalProperties: false

examples:
  - |
    i2c {
      #address-cells = <1>;
      #size-cells = <0>;

      fuel-gauge@71 {
        compatible = "siliconmitus,sm5705-fuel-gauge";
        reg = <0x71>;
        monitored-battery = <&battery>;
      };
    };
```
