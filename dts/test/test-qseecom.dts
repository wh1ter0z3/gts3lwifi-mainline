// SPDX-License-Identifier: BSD-3-Clause
#include "test-wdt.dts"

/*
 * Test: QSEE app buffers. Downstream's qseecom_mem is a reusable CMA pool
 * (shared-dma-pool, below 4 GB, 4 MiB aligned, 20 MiB), the ION "DMA" heap
 * app buffers are allocated from; the main DTS reserves it no-map, so
 * nothing can map it. Make it the SCM device's memory region instead, so
 * that dma_alloc_coherent() on the SCM device gives TZ-mappable buffers.
 */

/delete-node/ &{/reserved-memory/memory@fec00000};

/ {
	reserved-memory {
		/*
		 * 40 MiB, not downstream's 20: the fingerprint app alone is
		 * 20 MiB and is loaded through this pool next to the other
		 * clients' buffers. Grows downwards from the same end.
		 */
		qseecom_mem: qseecom@fd400000 {
			compatible = "shared-dma-pool";
			reg = <0x0 0xfd400000 0x0 0x2c00000>;
			reusable;
			/* the default CMA area: exported as /dev/dma_heap/reserved */
			linux,cma-default;
		};
	};
};

&{/firmware/scm} {
	memory-region = <&qseecom_mem>;
};
