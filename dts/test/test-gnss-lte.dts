// SPDX-License-Identifier: BSD-3-Clause
/*
 * Test: GNSS on the SM-T825 - its DT plus the modem DSP (gnss.dtsi).
 * Untested: we have no SM-T825 and no dump of its modem partition. The
 * stock DT gives both models the same modem_mem carve-out, so the LTE
 * modem image should fit; if it does not, the kernel says "segment
 * outside memory range" and nothing is loaded. docs/gnss.md.
 */

#include "../msm8996-samsung-gts3llte.dts"
#include "gnss.dtsi"
