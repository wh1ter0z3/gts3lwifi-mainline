#include "../apq8096-samsung-gts3lwifi.dts"

/* Test D: reserve only fingerprint SPI (25-28) and eSE SPI (58-61) */
&tlmm {
	/delete-property/ gpio-reserved-ranges;
	gpio-reserved-ranges = <25 4>, <58 4>;
};
