// SPDX-License-Identifier: BSD-3-Clause
#include "test-idle-fpc.dts"

/*
 * Test: the APSS watchdog (downstream qcom,wdt@9830000, bark/bite on SPI
 * 28/29), so that systemd (systemd.watchdog_sec=) resets a hung test
 * kernel into lk2nd instead of it hanging until the battery is pulled.
 */

&soc {
	watchdog@9830000 {
		compatible = "qcom,apss-wdt-msm8994", "qcom,kpss-wdt";
		reg = <0x09830000 0x1000>;
		interrupts = <GIC_SPI 28 IRQ_TYPE_EDGE_RISING>,
			     <GIC_SPI 29 IRQ_TYPE_EDGE_RISING>;
		clocks = <&sleep_clk>;
	};
};
